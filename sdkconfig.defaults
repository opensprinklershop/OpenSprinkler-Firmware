## sdkconfig.defaults
```kconfig
# ESP32-C5 Configuration for OpenSprinkler Firmware
# Note: mbedTLS settings are NOT included here because Arduino-ESP32 uses
# precompiled mbedTLS libraries. TLS cipher suites are configured at runtime
# in Esp32LocalServer.cpp using mbedtls_ssl_conf_ciphersuites().

# =============================================================================
# WiFi + Zigbee + BLE Coexistence Configuration (ESP32-C5)
# =============================================================================
# Reference: https://docs.espressif.com/projects/esp-idf/en/stable/esp32c5/api-guides/coexist.html
#
# Supported Scenarios:
#  - WiFi STA + Zigbee End Device + BLE: Stable (Y)
#  - WiFi STA + Zigbee Router + BLE: Unstable (C1) - may experience packet loss
#  - WiFi SOFTAP + Zigbee Router: Not supported (X)
#
# Note: Zigbee Routers maintain unsynchronized links requiring continuous reception.
# High WiFi/BLE traffic increases Zigbee packet loss. For production Zigbee Gateway,
# Espressif recommends dual-SoC (ESP32-S3 + ESP32-H2) with separate antennas.

# --- Enable Software Coexistence ---
CONFIG_ESP_COEX_SW_COEXIST_ENABLE=y

# --- Enable Bluetooth LE ---
CONFIG_BT_ENABLED=y
CONFIG_BT_BLE_ENABLED=y
# CONFIG_BT_CLASSIC_ENABLED is not set

# --- BLE Memory Optimization (for 400KB SRAM) ---
CONFIG_BT_BLE_DYNAMIC_ENV_MEMORY=y
CONFIG_BT_NIMBLE_ENABLED=y
# CONFIG_BT_BLUEDROID_ENABLED is not set

# --- WiFi Memory Optimization for Coexistence ---
CONFIG_ESP_WIFI_STATIC_RX_BUFFER_NUM=4
CONFIG_ESP_WIFI_DYNAMIC_RX_BUFFER_NUM=8
CONFIG_ESP_WIFI_DYNAMIC_TX_BUFFER=y
CONFIG_ESP_WIFI_DYNAMIC_TX_BUFFER_NUM=8
CONFIG_ESP_WIFI_TX_BA_WIN=4
CONFIG_ESP_WIFI_RX_BA_WIN=4
CONFIG_ESP_WIFI_MGMT_SBUF_NUM=16
# CONFIG_ESP_WIFI_RX_IRAM_OPT is not set

# --- LWIP Memory Optimization ---
CONFIG_LWIP_TCP_SND_BUF_DEFAULT=5744
CONFIG_LWIP_TCP_WND_DEFAULT=5744
CONFIG_LWIP_TCP_RECVMBOX_SIZE=4
CONFIG_LWIP_UDP_RECVMBOX_SIZE=4
CONFIG_LWIP_TCPIP_RECVMBOX_SIZE=16

# --- IEEE 802.15.4 (Zigbee) Priority ---
# Normal Zigbee RX has lowest priority (WiFi/BLE preempt)
# Zigbee TX/ACK have higher priority (depends on WiFi/BLE state)
# For best Zigbee performance: use WiFi STA (not SOFTAP) + End Device (not Router)
```
